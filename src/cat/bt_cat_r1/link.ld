SECTIONS { . = 0x0806126c; .payload : { *(.text) } }
oem_wire = 0x0800c4ed;
ble_resume = 0x0800a4b1;
parser = 0x080718b1;
ack_resume = 0x0807177f;
reply_resume = 0x08071b1f;
pack_freq = 0x08071b85;
packed_resume = 0x08071b59;
